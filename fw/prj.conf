## CMakeLists.txt
```
cmake_minimum_required(VERSION 3.20.0)

# Single-board firmware, so "west build firmware/fw" needs no -b option.
set(BOARD adafruit_feather_esp32c6/esp32c6/hpcore)

# Panel fitted on the Waveshare module. The "Rev2.1" marking of the PCB names
# the driver board, not the panel.
#   v1: UC8176 controller, BUSY idles high.
#   v2: SSD1683 controller, "V2" sticker on the back, BUSY idles low.
# Select with "west build firmware/fw -- -DPANEL=v2".
set(PANEL v1 CACHE STRING "Waveshare 4.2 inch panel revision (v1 or v2)")
set(panel_overlay ${CMAKE_CURRENT_SOURCE_DIR}/panels/waveshare_4in2_${PANEL}.overlay)
if(NOT EXISTS ${panel_overlay})
  message(FATAL_ERROR "Unknown PANEL '${PANEL}', expected v1 or v2")
endif()
list(APPEND EXTRA_DTC_OVERLAY_FILE ${panel_overlay})

# The Wi-Fi credentials stay out of git, see wifi.conf.example.
set(wifi_conf ${CMAKE_CURRENT_SOURCE_DIR}/wifi.conf)
if(EXISTS ${wifi_conf})
  list(APPEND EXTRA_CONF_FILE ${wifi_conf})
else()
  message(WARNING "fw/wifi.conf is missing, this firmware will not join any Wi-Fi network. "
                  "Copy fw/wifi.conf.example to fw/wifi.conf and fill it in.")
endif()

find_package(Zephyr REQUIRED HINTS $ENV{ZEPHYR_BASE})
project(epaper_notes)

list(APPEND CMAKE_MODULE_PATH ${ZEPHYR_BASE}/modules/nanopb)
include(nanopb)

# Generated sources live outside src/ or below it, and include its headers.
target_include_directories(app PRIVATE src)

target_sources(app PRIVATE
  src/main.c
  src/battery.c
  src/canvas.c
  src/panel.c
  src/upload_server.c
  src/wifi_link.c
  src/fonts/font_title.c
  src/fonts/font_body.c
)

# The upload protocol, generated as proto/epaper.pb.h in the build directory.
zephyr_nanopb_sources(app proto/epaper.proto)

# assets/picture.png is dithered to 1 bpp and compiled in at build time.
set(picture_c ${CMAKE_CURRENT_BINARY_DIR}/picture.c)
add_custom_command(
  OUTPUT ${picture_c}
  COMMAND ${PYTHON_EXECUTABLE} ${CMAKE_CURRENT_SOURCE_DIR}/scripts/img2c.py
          ${CMAKE_CURRENT_SOURCE_DIR}/assets/picture.png ${picture_c}
          --name picture --max-width 160 --max-height 160
  DEPENDS
    ${CMAKE_CURRENT_SOURCE_DIR}/scripts/img2c.py
    ${CMAKE_CURRENT_SOURCE_DIR}/assets/picture.png
)
target_sources(app PRIVATE ${picture_c})
```

## Kconfig
```
mainmenu "E-paper notes firmware"

config APP_DISPLAY_FLIP_180
	bool "Rotate the rendered frame by 180 degrees"
	help
	  Enable when the panel is mounted with the flat cable on the
	  opposite side and the picture shows upside down.

config APP_WIFI_SSID
	string "Name of the Wi-Fi network to join"
	help
	  Set it in wifi.conf, which stays out of git, and not in prj.conf.
	  The firmware skips the network when this is empty.

config APP_WIFI_PSK
	string "WPA2 or WPA3 personal key of the Wi-Fi network"
	help
	  Set it in wifi.conf, which stays out of git, and not in prj.conf.

config APP_UPLOAD_PORT
	int "TCP port of the frame upload server"
	default 7400
	range 1 65535
	help
	  Port on which the firmware accepts the requests defined in
	  proto/epaper.proto. tools/upload/upload.py uses the same default.

source "Kconfig.zephyr"
```

## prj.conf
```kconfig
CONFIG_DISPLAY=y
CONFIG_LOG=y

# MAX17048 of the Feather. The board defaults switch its I2C power domain on.
CONFIG_FUEL_GAUGE=y

# Wi-Fi station. The credentials come from wifi.conf, see wifi.conf.example.
CONFIG_WIFI=y
CONFIG_ESP32_WIFI_STA_RECONNECT=y
CONFIG_NETWORKING=y
CONFIG_NET_L2_ETHERNET=y
CONFIG_NET_IPV4=y
CONFIG_NET_IPV6=n
CONFIG_NET_DHCPV4=y
CONFIG_NET_TCP=y
CONFIG_NET_MGMT=y
CONFIG_NET_MGMT_EVENT=y
# The Wi-Fi events carry their status in the event info.
CONFIG_NET_MGMT_EVENT_INFO=y

# Frame upload server.
CONFIG_NET_SOCKETS=y
# A stalled client must time out, see upload_server.c.
CONFIG_NET_CONTEXT_RCVTIMEO=y
CONFIG_NANOPB=y
# main() runs the server, which decodes the request and draws the frame.
CONFIG_MAIN_STACK_SIZE=4096
```

## src/main.c
```c
/*
 * Joins the Wi-Fi network, shows a boot screen that gives the address of the
 * board and the state of its battery, then displays every frame a client
 * uploads. Until the first upload, the boot screen follows the address of the
 * board.
 */

#include <errno.h>
#include <stdbool.h>
#include <string.h>

#include <zephyr/device.h>
#include <zephyr/devicetree.h>
#include <zephyr/kernel.h>
#include <zephyr/logging/log.h>
#include <zephyr/net/net_ip.h>
#include <zephyr/sys/printk.h>
#include <zephyr/sys/util.h>

#include "battery.h"
#include "canvas.h"
#include "panel.h"
#include "picture.h"
#include "upload_server.h"
#include "wifi_link.h"

LOG_MODULE_REGISTER(app, LOG_LEVEL_INF);

#define MARGIN        16
#define HEADER_HEIGHT 64
#define LINE_SPACING  8

/*
 * Joining plus DHCP takes about 5 s. Past this delay the boot screen goes up
 * without an address, so that a network fault does not leave the panel blank.
 */
#define WIFI_ADDRESS_TIMEOUT K_SECONDS(30)

/*
 * The vendor asks for 180 s between two full refreshes. An upload is the call
 * of the user, whereas a redraw of the boot screen can wait.
 */
#define REDRAW_SPACING K_SECONDS(180)

#define WATCHER_STACK_SIZE 2048

#define WIFI_OFFLINE_TEXT "Wi-Fi hors ligne"

#define BATTERY_UNKNOWN_TEXT "Batterie inconnue"

static const struct device *const display = DEVICE_DT_GET(DT_CHOSEN(zephyr_display));
static const struct device *const gauge = DEVICE_DT_GET(DT_ALIAS(fuel_gauge0));

/*
 * The upload callback and the boot screen watcher draw and refresh from two
 * threads, so this lock covers the canvas, the panel and frame_uploaded.
 */
static K_MUTEX_DEFINE(screen_lock);

/* Set by the first upload, after which the boot screen never comes back. */
static bool frame_uploaded;

/*
 * Address on the boot screen, empty when it reads WIFI_OFFLINE_TEXT or when
 * the boot screen never went up. main() owns it until the watcher starts.
 */
static char shown_address[NET_IPV4_ADDR_LEN];

static void draw_centered_text(int y, const struct font *font, enum canvas_color color,
			       const char *text)
{
	const int x = (CANVAS_WIDTH - canvas_text_width(font, text)) / 2;

	canvas_draw_text(x, y, font, color, text);
}

/* battery is NULL when the fuel gauge could not be read. */
static void compose_boot_screen(const char *network_line, const struct battery_reading *battery)
{
	char port_line[sizeof("Port TCP 65535")];
	char charge_line[sizeof("Batterie 255 %")];
	char voltage_line[sizeof("Tension 99,99 V")];
	/* One line would not fit next to the picture, hence two for the battery. */
	const char *lines[6] = {
		"Zephyr RTOS",
		"ESP32-C6 Feather",
		network_line,
		port_line,
	};
	size_t line_count = 4;
	const int body_top = HEADER_HEIGHT;
	const int body_height = CANVAS_HEIGHT - HEADER_HEIGHT;
	const int text_x = MARGIN + picture.width + MARGIN;
	int text_height;
	int y;

	snprintk(port_line, sizeof(port_line), "Port TCP %d", CONFIG_APP_UPLOAD_PORT);

	if (battery != NULL) {
		snprintk(charge_line, sizeof(charge_line), "Batterie %u %%", battery->charge_pct);
		snprintk(voltage_line, sizeof(voltage_line), "Tension %d,%02d V",
			 battery->voltage_mv / 1000, battery->voltage_mv % 1000 / 10);
		lines[line_count++] = charge_line;
		lines[line_count++] = voltage_line;
	} else {
		lines[line_count++] = BATTERY_UNKNOWN_TEXT;
	}

	text_height = line_count * font_body.height + (line_count - 1) * LINE_SPACING;

	canvas_clear(CANVAS_WHITE);

	canvas_fill_rect(0, 0, CANVAS_WIDTH, HEADER_HEIGHT, CANVAS_BLACK);
	draw_centered_text((HEADER_HEIGHT - font_title.height) / 2, &font_title, CANVAS_WHITE,
			   "Bonjour Maïa !");

	canvas_draw_bitmap(MARGIN, body_top + (body_height - picture.height) / 2, &picture);

	y = body_top + (body_height - text_height) / 2;
	for (size_t i = 0; i < line_count; i++) {
		canvas_draw_text(text_x, y, &font_body, CANVAS_BLACK, lines[i]);
		y += font_body.height + LINE_SPACING;
	}
}

static int show_uploaded_frame(const struct canvas_bitmap *frame)
{
	int err;

	k_mutex_lock(&screen_lock, K_FOREVER);

	if (panel_is_busy()) {
		err = -EBUSY;
	} else {
		/* The canvas belongs to the frame from here on, even if the refresh fails. */
		frame_uploaded = true;
		canvas_draw_bitmap(0, 0, frame);

		LOG_INF("Refreshing the panel, this takes a few seconds");

		err = panel_refresh();
	}

	k_mutex_unlock(&screen_lock);

	return err;
}

/*
 * Puts the boot screen up with a fresh battery reading and the given address,
 * empty for none.
 *
 * Returns -ECANCELED once an upload took the screen over, -EBUSY while the
 * panel is held by an earlier call, and the error of the refresh otherwise.
 */
static int show_boot_screen(const char *address)
{
	struct battery_reading battery;
	bool battery_known;
	int err;

	k_mutex_lock(&screen_lock, K_FOREVER);

	if (frame_uploaded) {
		err = -ECANCELED;
	} else if (panel_is_busy()) {
		err = -EBUSY;
	} else {
		battery_known = battery_read(gauge, &battery) == 0;
		if (battery_known) {
			LOG_INF("Battery at %u mV, %u %%", battery.voltage_mv, battery.charge_pct);
		}

		compose_boot_screen(address[0] != '\0' ? address : WIFI_OFFLINE_TEXT,
				    battery_known ? &battery : NULL);

		/*
		 * Holds even when the refresh times out, because the flush that
		 * resumes reads the canvas.
		 */
		snprintk(shown_address, sizeof(shown_address), "%s", address);

		LOG_INF("Refreshing the panel, this takes a few seconds");

		err = panel_refresh();
	}

	k_mutex_unlock(&screen_lock);

	return err;
}

/*
 * Redraws the boot screen when the board receives an address that the screen
 * does not show, which covers a link that comes up after the boot screen and
 * a new DHCP lease after an outage. A lost link alone redraws nothing, since
 * the driver rejoins and a refresh flashes the panel for seconds.
 */
static void keep_boot_screen_current(void *p1, void *p2, void *p3)
{
	char address[NET_IPV4_ADDR_LEN];
	int err;

	ARG_UNUSED(p1);
	ARG_UNUSED(p2);
	ARG_UNUSED(p3);

	for (;;) {
		/*
		 * This thread starts right after the boot screen refresh, and an
		 * upload ends it, so every refresh before this point is either
		 * that one or its own. The sleep also paces the retries while
		 * the panel is stalled.
		 */
		k_sleep(REDRAW_SPACING);

		err = wifi_link_wait_for_address(shown_address, K_FOREVER, address,
						 sizeof(address));
		if (err < 0) {
			LOG_ERR("Boot screen no longer follows the address (%d)", err);
			return;
		}

		err = show_boot_screen(address);
		if (err == -ECANCELED) {
			return;
		}

		if (err < 0) {
			LOG_WRN("Boot screen not redrawn with %s (%d)", address, err);
		} else {
			LOG_INF("Boot screen redrawn with %s", address);
		}
	}
}

K_THREAD_DEFINE(boot_screen_watcher, WATCHER_STACK_SIZE, keep_boot_screen_current, NULL, NULL,
		NULL, K_PRIO_PREEMPT(1), 0, SYS_FOREVER_MS);

/*
 * Writes the IPv4 address into address, which stays empty when the link did
 * not come up in time. Returns false when no join is under way, in which case
 * no address will ever come.
 */
static bool bring_up_network(char *address, size_t address_size)
{
	int err;

	address[0] = '\0';

	if (strlen(CONFIG_APP_WIFI_SSID) == 0) {
		LOG_ERR("No Wi-Fi credentials in this build. Copy fw/wifi.conf.example to "
			"fw/wifi.conf, fill it in and rebuild");
		return false;
	}

	if (wifi_link_join(CONFIG_APP_WIFI_SSID, CONFIG_APP_WIFI_PSK) < 0) {
		return false;
	}

	err = wifi_link_wait_for_address("", WIFI_ADDRESS_TIMEOUT, address, address_size);
	if (err == -EAGAIN) {
		LOG_WRN("No IPv4 address yet, the boot screen follows once it comes");
	} else if (err < 0) {
		LOG_ERR("Cannot read the IPv4 address (%d)", err);
	}

	return true;
}

int main(void)
{
	char address[NET_IPV4_ADDR_LEN];
	bool joining;
	int err;

	LOG_INF("Initializing the panel");

	err = panel_init(display);
	if (err < 0 && err != -ETIMEDOUT) {
		LOG_ERR("Panel initialization failed (%d)", err);
		return err;
	}

	joining = bring_up_network(address, sizeof(address));

	err = show_boot_screen(address);
	if (err == -EBUSY) {
		LOG_ERR("Boot screen skipped, the panel init is still stalled");
	} else if (err < 0) {
		LOG_ERR("Boot screen not shown (%d)", err);
	}

	if (joining) {
		k_thread_start(boot_screen_watcher);
	}

	/*
	 * A stalled panel must not take the network service down with it, so
	 * the server starts either way and tells its clients about the panel.
	 */
	return upload_server_run(CONFIG_APP_UPLOAD_PORT, show_uploaded_frame);
}
```

## src/battery.c
```c
/*
 * The MAX17048 of the Feather sits on the I2C bus behind the power domain of
 * the board, which the board defaults switch on before the bus. The Zephyr
 * driver checks the version register during its init, so a gauge that is not
 * ready never answered.
 */

#include <errno.h>

#include <zephyr/drivers/fuel_gauge.h>
#include <zephyr/logging/log.h>
#include <zephyr/sys/util.h>

#include "battery.h"

LOG_MODULE_REGISTER(battery, LOG_LEVEL_INF);

int battery_read(const struct device *gauge, struct battery_reading *reading)
{
	const fuel_gauge_prop_t props[] = {
		FUEL_GAUGE_VOLTAGE_UV,
		FUEL_GAUGE_RELATIVE_STATE_OF_CHARGE_PCT,
	};
	union fuel_gauge_prop_val vals[ARRAY_SIZE(props)];
	int err;

	if (!device_is_ready(gauge)) {
		LOG_ERR("The fuel gauge did not answer during its init");
		return -ENODEV;
	}

	err = fuel_gauge_get_props(gauge, props, vals, ARRAY_SIZE(props));
	if (err < 0) {
		LOG_ERR("Cannot read the fuel gauge (%d)", err);
		return err;
	}

	/* The gauge tops out at 5.12 V, so the clamp only guards the narrowing. */
	reading->voltage_mv = CLAMP(vals[0].voltage_uv / 1000, 0, UINT16_MAX);
	reading->charge_pct = vals[1].relative_state_of_charge_pct;

	return 0;
}
```

## src/battery.h
```c
/*
 * State of the LiPo battery, read from the fuel gauge of the board.
 */

#ifndef BATTERY_H_
#define BATTERY_H_

#include <stdint.h>

#include <zephyr/device.h>

struct battery_reading {
	uint16_t voltage_mv;
	uint8_t charge_pct;
};

/*
 * Read the battery through its fuel gauge.
 *
 * Returns -ENODEV when the gauge did not answer during its init, and the
 * error of the driver when a read fails.
 */
int battery_read(const struct device *gauge, struct battery_reading *reading);

#endif /* BATTERY_H_ */
```

## src/canvas.h
```c
/*
 * 1 bpp landscape frame buffer for the e-paper panel.
 *
 * Draw into the canvas, then push it to the panel with canvas_flush(). A
 * flush costs one full refresh of several seconds, so compose the whole
 * screen before flushing.
 */

#ifndef CANVAS_H_
#define CANVAS_H_

#include <stdint.h>

#include <zephyr/device.h>
#include <zephyr/devicetree.h>

#include "font.h"

#define CANVAS_DISPLAY_NODE DT_CHOSEN(zephyr_display)

/* Landscape resolution, 400x300 on both panel revisions. */
#if DT_NODE_HAS_COMPAT(CANVAS_DISPLAY_NODE, solomon_ssd1683)
/*
 * The SSD16xx binding names the gate lines "width" and the source lines
 * "height", hence the swap.
 */
#define CANVAS_WIDTH  DT_PROP(CANVAS_DISPLAY_NODE, height)
#define CANVAS_HEIGHT DT_PROP(CANVAS_DISPLAY_NODE, width)
#else
#define CANVAS_WIDTH  DT_PROP(CANVAS_DISPLAY_NODE, width)
#define CANVAS_HEIGHT DT_PROP(CANVAS_DISPLAY_NODE, height)
#endif

enum canvas_color {
	CANVAS_BLACK,
	CANVAS_WHITE,
};

struct canvas_bitmap {
	uint16_t width;
	uint16_t height;
	/* 1 bpp, MSB first, rows padded to a byte, a set bit is black. */
	const uint8_t *data;
};

void canvas_clear(enum canvas_color color);

void canvas_set_pixel(int x, int y, enum canvas_color color);

void canvas_fill_rect(int x, int y, int width, int height, enum canvas_color color);

/* Opaque blit, clear bits of the bitmap are drawn white. */
void canvas_draw_bitmap(int x, int y, const struct canvas_bitmap *bitmap);

/*
 * Draw UTF-8 text with (x, y) as the top left corner of the first glyph.
 * Characters missing from the font show as '?'.
 *
 * Returns the x coordinate that follows the last glyph.
 */
int canvas_draw_text(int x, int y, const struct font *font, enum canvas_color color,
		     const char *text);

int canvas_text_width(const struct font *font, const char *text);

/* Send the canvas to the panel and start one full refresh. */
int canvas_flush(const struct device *display);

#endif /* CANVAS_H_ */
```

## src/font.h
```c
/*
 * Bitmap font tables generated by scripts/font2c.py.
 */

#ifndef FONT_H_
#define FONT_H_

#include <stdint.h>

struct font_glyph {
	/* Unicode code point, Basic Multilingual Plane only. */
	uint16_t codepoint;
	/* Horizontal advance in pixels, which is also the bitmap width. */
	uint8_t advance;
	/* Offset of the glyph bitmap in font.bitmaps. */
	uint32_t offset;
};

struct font {
	/* Line height in pixels, which is also the height of every bitmap. */
	uint8_t height;
	uint16_t glyph_count;
	/* Sorted by code point. */
	const struct font_glyph *glyphs;
	/* 1 bpp, MSB first, rows padded to a byte, a set bit is ink. */
	const uint8_t *bitmaps;
};

extern const struct font font_title;
extern const struct font font_body;

#endif /* FONT_H_ */
```

## src/panel.c
```c
/*
 * One worker thread runs one display call at a time. The caller hands it over
 * and waits on a semaphore with a timeout, which is the only way to bound a
 * driver call that cannot be interrupted.
 */

#include <errno.h>

#include <zephyr/drivers/gpio.h>
#include <zephyr/kernel.h>
#include <zephyr/logging/log.h>
#include <zephyr/sys/atomic.h>

#include "canvas.h"
#include "panel.h"

LOG_MODULE_REGISTER(panel, LOG_LEVEL_INF);

/*
 * A healthy panel finishes its init in 0.1 s and a full refresh in 5 s. The
 * slowest refresh that still completed on the hardware took 13 s.
 */
#define PANEL_CALL_TIMEOUT_S 20

#define WORKER_STACK_SIZE 2048

/* Far longer than the time an internal pull needs to move an undriven wire. */
#define PULL_SETTLE_US 100

/* Owned by the display driver. Only observed here, to qualify a stall. */
static const struct gpio_dt_spec busy_pin = GPIO_DT_SPEC_GET(CANVAS_DISPLAY_NODE, busy_gpios);

static const struct device *panel;
static bool panel_ready;

static int (*job)(const struct device *display);
static int job_result;
static atomic_t job_running;
/* Set when the caller stopped waiting, so that the worker reports the end. */
static atomic_t job_abandoned;
static K_SEM_DEFINE(job_start, 0, 1);
static K_SEM_DEFINE(job_done, 0, 1);

static void run_jobs(void *p1, void *p2, void *p3)
{
	ARG_UNUSED(p1);
	ARG_UNUSED(p2);
	ARG_UNUSED(p3);

	for (;;) {
		k_sem_take(&job_start, K_FOREVER);

		job_result = job(panel);

		if (atomic_get(&job_abandoned) != 0) {
			LOG_WRN("The stalled panel call ended (%d), the panel accepts calls again",
				job_result);
		}

		atomic_clear(&job_running);
		k_sem_give(&job_done);
	}
}

K_THREAD_DEFINE(panel_worker, WORKER_STACK_SIZE, run_jobs, NULL, NULL, NULL, K_PRIO_PREEMPT(0), 0,
		0);

/*
 * A line that follows the weak internal pulls is driven by no one, which means
 * a broken BUSY connection and not a busy panel. Interrupts stay locked so
 * that the driver, which polls this pin, never sees the forced level, and the
 * opposite pull then puts the line back to the busy level it was found at.
 *
 * Returns 1 when the line floats, 0 when something drives it, or a negative
 * errno when the pin could not be probed.
 */
static int busy_line_floats(void)
{
	const bool active_low = (busy_pin.dt_flags & GPIO_ACTIVE_LOW) != 0;
	const gpio_flags_t release_pull = active_low ? GPIO_PULL_UP : GPIO_PULL_DOWN;
	const gpio_flags_t restore_pull = active_low ? GPIO_PULL_DOWN : GPIO_PULL_UP;
	const unsigned int key = irq_lock();
	int released = 0;
	int err;
	int restore_err;

	err = gpio_pin_configure_dt(&busy_pin, GPIO_INPUT | release_pull);
	if (err == 0) {
		k_busy_wait(PULL_SETTLE_US);
		released = gpio_pin_get_dt(&busy_pin);

		err = gpio_pin_configure_dt(&busy_pin, GPIO_INPUT | restore_pull);
		k_busy_wait(PULL_SETTLE_US);
	}

	/* Attempted in every case, the driver needs its plain input back. */
	restore_err = gpio_pin_configure_dt(&busy_pin, GPIO_INPUT);

	irq_unlock(key);

	if (err == 0) {
		err = restore_err;
	}
	if (err < 0) {
		return err;
	}
	if (released < 0) {
		return released;
	}

	return released == 0;
}

static void report_stall(const char *call_name)
{
	const int busy = gpio_pin_get_dt(&busy_pin);
	int floats;

	if (busy < 0) {
		LOG_ERR("Panel %s not finished after %d s, and the BUSY pin cannot be read (%d)",
			call_name, PANEL_CALL_TIMEOUT_S, busy);
		return;
	}

	if (busy == 0) {
		LOG_ERR("Panel %s not finished after %d s although BUSY is released, so the call "
			"is stuck on the SPI side and not in the panel",
			call_name, PANEL_CALL_TIMEOUT_S);
		return;
	}

	floats = busy_line_floats();
	if (floats < 0) {
		LOG_ERR("Panel %s not finished after %d s with BUSY active, and the line could "
			"not be probed (%d)",
			call_name, PANEL_CALL_TIMEOUT_S, floats);
	} else if (floats > 0) {
		LOG_ERR("Panel %s not finished after %d s because the BUSY line floats. It "
			"follows the internal pull resistors, so nothing drives it. Check the "
			"BUSY wire and its contacts between the module and the board",
			call_name, PANEL_CALL_TIMEOUT_S);
	} else {
		LOG_ERR("Panel %s not finished after %d s and the panel really drives BUSY. "
			"Check the panel supply and flat cable, the RST wiring, and that the "
			"PANEL build option matches the panel revision",
			call_name, PANEL_CALL_TIMEOUT_S);
	}
}

static int run_bounded(int (*call)(const struct device *display), const char *call_name)
{
	if (!atomic_cas(&job_running, 0, 1)) {
		return -EBUSY;
	}

	atomic_clear(&job_abandoned);
	k_sem_reset(&job_done);
	job = call;
	k_sem_give(&job_start);

	if (k_sem_take(&job_done, K_SECONDS(PANEL_CALL_TIMEOUT_S)) < 0) {
		atomic_set(&job_abandoned, 1);
		report_stall(call_name);
		return -ETIMEDOUT;
	}

	return job_result;
}

static int init_display(const struct device *display)
{
	const int err = device_init(display);

	panel_ready = (err == 0);

	return err;
}

int panel_init(const struct device *display)
{
	panel = display;

	return run_bounded(init_display, "init");
}

int panel_refresh(void)
{
	if (panel_is_busy()) {
		return -EBUSY;
	}

	/* The display API must not run on a device whose init failed. */
	if (!panel_ready) {
		return -ENODEV;
	}

	return run_bounded(canvas_flush, "refresh");
}

bool panel_is_busy(void)
{
	return atomic_get(&job_running) != 0;
}
```

## src/panel.h
```c
/*
 * Bounded access to the e-paper panel.
 *
 * Neither e-paper driver has a timeout on BUSY, so a panel fault blocks the
 * calling thread forever. This module runs the blocking display calls on a
 * worker thread and makes its caller wait for a bounded time only.
 *
 * Both calls return -ETIMEDOUT when the panel does not finish in time. The
 * call then keeps running on the worker, and every call returns -EBUSY until
 * it ends, which it does on its own if the panel recovers.
 */

#ifndef PANEL_H_
#define PANEL_H_

#include <stdbool.h>

#include <zephyr/device.h>

/*
 * Initialize the display device, whose node carries zephyr,deferred-init so
 * that nothing waits on the panel before the console is up.
 */
int panel_init(const struct device *display);

/* Send the canvas to the panel and run one full refresh. */
int panel_refresh(void);

/*
 * True while a call that timed out is still running. It may read the canvas
 * when it resumes, so do not draw while this holds.
 */
bool panel_is_busy(void);

#endif /* PANEL_H_ */
```

## src/picture.h
```c
/*
 * Picture generated from assets/picture.png by scripts/img2c.py.
 */

#ifndef PICTURE_H_
#define PICTURE_H_

#include "canvas.h"

extern const struct canvas_bitmap picture;

#endif /* PICTURE_H_ */
```

## src/upload_server.c
```c
/*
 * One request and one response per connection, both in the protobuf delimited
 * format (a varint length, then the message). The request is decoded straight
 * from the socket, so no buffer holds the encoded frame.
 */

#include <errno.h>
#include <stdint.h>

#include <zephyr/kernel.h>
#include <zephyr/logging/log.h>
#include <zephyr/net/socket.h>
#include <zephyr/sys/printk.h>
#include <zephyr/sys/util.h>

#include <pb_decode.h>
#include <pb_encode.h>

#include "proto/epaper.pb.h"
#include "upload_server.h"

LOG_MODULE_REGISTER(upload_server, LOG_LEVEL_INF);

/* A client that stalls mid-request must not hold the only server slot. */
#define CLIENT_RECEIVE_TIMEOUT_S 10

#define ACCEPT_RETRY_DELAY K_SECONDS(1)

/* A varint that encodes a 32 bit length. */
#define LENGTH_PREFIX_MAX_BYTES 5

#define FRAME_BYTES (CANVAS_WIDTH / 8 * CANVAS_HEIGHT)

BUILD_ASSERT(sizeof(((epaper_ShowFrame *)0)->pixels.bytes) == FRAME_BYTES,
	     "pixels max_size in proto/epaper.options must hold exactly one canvas frame");

/* Too large for a stack, and the server handles one client at a time. */
static epaper_Request request;

static bool read_socket(pb_istream_t *stream, pb_byte_t *buf, size_t count)
{
	const int sock = POINTER_TO_INT(stream->state);

	while (count > 0) {
		const ssize_t received = zsock_recv(sock, buf, count, 0);

		if (received <= 0) {
			/*
			 * Closed by the peer, timed out or failed. Marking the
			 * stream empty keeps nanopb from draining the rest of
			 * the message, which would wait for a second timeout.
			 */
			stream->bytes_left = 0;
			return false;
		}

		buf += received;
		count -= received;
	}

	return true;
}

static int send_all(int sock, const uint8_t *buf, size_t len)
{
	while (len > 0) {
		const ssize_t sent = zsock_send(sock, buf, len, 0);

		if (sent < 0) {
			return -errno;
		}

		buf += sent;
		len -= sent;
	}

	return 0;
}

static void reply(int client, epaper_Response_Status status, const char *detail)
{
	uint8_t encoded[epaper_Response_size + LENGTH_PREFIX_MAX_BYTES];
	pb_ostream_t stream = pb_ostream_from_buffer(encoded, sizeof(encoded));
	epaper_Response response = epaper_Response_init_zero;
	int err;

	response.status = status;
	snprintk(response.detail, sizeof(response.detail), "%s", detail);

	if (!pb_encode_ex(&stream, epaper_Response_fields, &response, PB_ENCODE_DELIMITED)) {
		LOG_ERR("Response encoding failed (%s)", PB_GET_ERROR(&stream));
		return;
	}

	err = send_all(client, encoded, stream.bytes_written);
	if (err < 0) {
		LOG_WRN("Response not delivered (%d)", err);
	}
}

static const char *display_error_detail(int err)
{
	switch (err) {
	case -EBUSY:
		return "the panel is still busy with an earlier call, retry later";
	case -ETIMEDOUT:
		return "the panel did not finish the refresh in time";
	default:
		return "the panel refused the frame";
	}
}

static void handle_show_frame(int client, const epaper_ShowFrame *frame,
			      upload_show_frame_t show_frame)
{
	const struct canvas_bitmap bitmap = {
		.width = CANVAS_WIDTH,
		.height = CANVAS_HEIGHT,
		.data = frame->pixels.bytes,
	};
	char detail[sizeof(((epaper_Response *)0)->detail)];
	int err;

	if (frame->width != CANVAS_WIDTH || frame->height != CANVAS_HEIGHT ||
	    frame->pixels.size != FRAME_BYTES) {
		snprintk(detail, sizeof(detail), "expected %dx%d and %d bytes, got %ux%u and %u",
			 CANVAS_WIDTH, CANVAS_HEIGHT, FRAME_BYTES, (unsigned int)frame->width,
			 (unsigned int)frame->height, (unsigned int)frame->pixels.size);
		LOG_WRN("Frame rejected, %s", detail);
		reply(client, epaper_Response_Status_STATUS_INVALID_REQUEST, detail);
		return;
	}

	LOG_INF("Frame received, refreshing the panel");

	err = show_frame(&bitmap);
	if (err < 0) {
		LOG_ERR("Frame not shown (%d)", err);
		reply(client, epaper_Response_Status_STATUS_DISPLAY_ERROR,
		      display_error_detail(err));
		return;
	}

	reply(client, epaper_Response_Status_STATUS_OK, "");
}

static void serve_client(int client, upload_show_frame_t show_frame)
{
	pb_istream_t stream = {
		.callback = read_socket,
		.state = INT_TO_POINTER(client),
		/*
		 * The largest well-formed request. A longer length prefix is
		 * then refused before any of its payload is read.
		 */
		.bytes_left = epaper_Request_size + LENGTH_PREFIX_MAX_BYTES,
	};

	if (!pb_decode_ex(&stream, epaper_Request_fields, &request, PB_DECODE_DELIMITED)) {
		LOG_WRN("Request rejected (%s)", PB_GET_ERROR(&stream));
		reply(client, epaper_Response_Status_STATUS_INVALID_REQUEST,
		      PB_GET_ERROR(&stream));
		return;
	}

	switch (request.which_command) {
	case epaper_Request_show_frame_tag:
		handle_show_frame(client, &request.command.show_frame, show_frame);
		break;
	default:
		LOG_WRN("Request rejected, no known command in it");
		reply(client, epaper_Response_Status_STATUS_INVALID_REQUEST, "unknown command");
		break;
	}
}

static int open_listening_socket(uint16_t port)
{
	const struct net_sockaddr_in address = {
		.sin_family = NET_AF_INET,
		.sin_port = net_htons(port),
		.sin_addr = {.s_addr = NET_INADDR_ANY},
	};
	const int reuse_address = 1;
	int server;
	int err;

	server = zsock_socket(NET_AF_INET, NET_SOCK_STREAM, NET_IPPROTO_TCP);
	if (server < 0) {
		return -errno;
	}

	/* Lets the port be bound again right after a reboot of the link. */
	if (zsock_setsockopt(server, ZSOCK_SOL_SOCKET, ZSOCK_SO_REUSEADDR, &reuse_address,
			     sizeof(reuse_address)) < 0) {
		LOG_WRN("Address reuse not enabled on the listening socket (%d)", -errno);
	}

	if (zsock_bind(server, (const struct net_sockaddr *)&address, sizeof(address)) < 0 ||
	    zsock_listen(server, 1) < 0) {
		err = -errno;
		zsock_close(server);
		return err;
	}

	return server;
}

int upload_server_run(uint16_t port, upload_show_frame_t show_frame)
{
	const struct zsock_timeval receive_timeout = {.tv_sec = CLIENT_RECEIVE_TIMEOUT_S};
	const int server = open_listening_socket(port);

	if (server < 0) {
		LOG_ERR("Cannot listen on TCP port %u (%d)", port, server);
		return server;
	}

	LOG_INF("Waiting for frames on TCP port %u", port);

	for (;;) {
		const int client = zsock_accept(server, NULL, NULL);

		if (client < 0) {
			LOG_ERR("Accept failed (%d)", -errno);
			k_sleep(ACCEPT_RETRY_DELAY);
			continue;
		}

		if (zsock_setsockopt(client, ZSOCK_SOL_SOCKET, ZSOCK_SO_RCVTIMEO, &receive_timeout,
				     sizeof(receive_timeout)) < 0) {
			LOG_WRN("No receive timeout on this client (%d)", -errno);
		}

		serve_client(client, show_frame);
		zsock_close(client);
	}
}
```

## src/upload_server.h
```c
/*
 * TCP server of the upload protocol defined in proto/epaper.proto.
 */

#ifndef UPLOAD_SERVER_H_
#define UPLOAD_SERVER_H_

#include <stdint.h>

#include "canvas.h"

/*
 * Receives a full screen frame that already passed validation. Returns 0 once
 * the frame is on the panel, or a negative errno. The client is told apart
 * -EBUSY, a panel still held by an earlier call, and -ETIMEDOUT, a refresh
 * that did not finish in time.
 */
typedef int (*upload_show_frame_t)(const struct canvas_bitmap *frame);

/*
 * Serve clients one at a time, forever. Only returns, with a negative errno,
 * when the listening socket cannot be set up.
 */
int upload_server_run(uint16_t port, upload_show_frame_t show_frame);

#endif /* UPLOAD_SERVER_H_ */
```

## src/wifi_link.c
```c
/*
 * The ESP32 driver does the heavy lifting. It starts the DHCP client once
 * associated (CONFIG_WIFI_STA_AUTO_DHCPV4) and rejoins after a loss
 * (CONFIG_ESP32_WIFI_STA_RECONNECT), so this module only issues the request
 * and reports what happens.
 */

#include <errno.h>
#include <string.h>

#include <zephyr/kernel.h>
#include <zephyr/logging/log.h>
#include <zephyr/net/net_if.h>
#include <zephyr/net/net_ip.h>
#include <zephyr/net/net_mgmt.h>
#include <zephyr/net/wifi.h>
#include <zephyr/net/wifi_mgmt.h>

#include "wifi_link.h"

LOG_MODULE_REGISTER(wifi_link, LOG_LEVEL_INF);

/* Wi-Fi and IPv4 events belong to different layers, hence two callbacks. */
static struct net_mgmt_event_callback wifi_events;
static struct net_mgmt_event_callback ipv4_events;

/* Only wakes the waiter up, the interface stays the source of truth. */
static K_SEM_DEFINE(address_added, 0, 1);

static void log_join_failure(enum wifi_conn_status status)
{
	switch (status) {
	case WIFI_STATUS_CONN_WRONG_PASSWORD:
		LOG_WRN("Access point refused the key, check CONFIG_APP_WIFI_PSK in wifi.conf");
		break;
	case WIFI_STATUS_CONN_AP_NOT_FOUND:
		LOG_WRN("Access point not found, check CONFIG_APP_WIFI_SSID in wifi.conf and "
			"the 2.4 GHz coverage");
		break;
	default:
		LOG_WRN("Joining the access point failed (status %d)", status);
		break;
	}
}

static void on_wifi_event(struct net_mgmt_event_callback *cb, uint64_t event, struct net_if *iface)
{
	const struct wifi_status *status = cb->info;

	ARG_UNUSED(iface);

	switch (event) {
	case NET_EVENT_WIFI_CONNECT_RESULT:
		if (status->conn_status == WIFI_STATUS_CONN_SUCCESS) {
			LOG_INF("Joined the access point");
		} else {
			log_join_failure(status->conn_status);
		}
		break;
	case NET_EVENT_WIFI_DISCONNECT_RESULT:
		LOG_WRN("Access point lost (reason %d), the driver rejoins", status->disconn_reason);
		break;
	default:
		break;
	}
}

static void on_ipv4_event(struct net_mgmt_event_callback *cb, uint64_t event, struct net_if *iface)
{
	char text[NET_IPV4_ADDR_LEN];
	const struct net_in_addr *address;

	ARG_UNUSED(cb);

	if (event != NET_EVENT_IPV4_ADDR_ADD) {
		return;
	}

	address = net_if_ipv4_get_global_addr(iface, NET_ADDR_PREFERRED);
	if (address != NULL) {
		LOG_INF("IPv4 address %s", net_addr_ntop(NET_AF_INET, address, text, sizeof(text)));
	}

	k_sem_give(&address_added);
}

int wifi_link_join(const char *ssid, const char *psk)
{
	struct net_if *iface = net_if_get_first_wifi();
	struct wifi_connect_req_params params = {
		.ssid = (const uint8_t *)ssid,
		.ssid_length = strlen(ssid),
		.psk = (const uint8_t *)psk,
		.psk_length = strlen(psk),
		/* A threshold for the ESP32 driver, WPA3 access points pass too. */
		.security = WIFI_SECURITY_TYPE_PSK,
		.channel = WIFI_CHANNEL_ANY,
		.band = WIFI_FREQ_BAND_2_4_GHZ,
		.mfp = WIFI_MFP_OPTIONAL,
	};
	int err;

	if (iface == NULL) {
		LOG_ERR("No Wi-Fi interface");
		return -ENODEV;
	}

	net_mgmt_init_event_callback(&wifi_events, on_wifi_event,
				     NET_EVENT_WIFI_CONNECT_RESULT |
					     NET_EVENT_WIFI_DISCONNECT_RESULT);
	net_mgmt_add_event_callback(&wifi_events);

	net_mgmt_init_event_callback(&ipv4_events, on_ipv4_event, NET_EVENT_IPV4_ADDR_ADD);
	net_mgmt_add_event_callback(&ipv4_events);

	LOG_INF("Joining \"%s\"", ssid);

	err = net_mgmt(NET_REQUEST_WIFI_CONNECT, iface, &params, sizeof(params));
	if (err < 0) {
		LOG_ERR("Wi-Fi connect request failed (%d)", err);
	}

	return err;
}

int wifi_link_wait_for_address(const char *known, k_timeout_t timeout, char *address,
			       size_t address_size)
{
	const k_timepoint_t deadline = sys_timepoint_calc(timeout);
	struct net_if *iface = net_if_get_first_wifi();
	/* Compared before address is written, so that known may be the same buffer. */
	char text[NET_IPV4_ADDR_LEN];

	if (iface == NULL) {
		return -ENODEV;
	}

	for (;;) {
		const struct net_in_addr *current =
			net_if_ipv4_get_global_addr(iface, NET_ADDR_PREFERRED);

		if (current != NULL &&
		    net_addr_ntop(NET_AF_INET, current, text, sizeof(text)) != NULL &&
		    strcmp(text, known) != 0) {
			if (strlen(text) >= address_size) {
				return -ENOSPC;
			}

			strcpy(address, text);

			return 0;
		}

		if (k_sem_take(&address_added, sys_timepoint_timeout(deadline)) < 0) {
			return -EAGAIN;
		}
	}
}
```

## src/wifi_link.h
```c
/*
 * Station mode Wi-Fi link to one access point, with a DHCP address.
 */

#ifndef WIFI_LINK_H_
#define WIFI_LINK_H_

#include <stddef.h>

#include <zephyr/kernel.h>

/*
 * Start joining the access point and return without waiting for the result.
 * The driver retries on its own and rejoins after a loss, so one call lasts
 * for the whole uptime.
 */
int wifi_link_join(const char *ssid, const char *psk);

/*
 * Wait for an IPv4 address whose text differs from known and write it into
 * address. An empty known accepts any address, and a caller that passes the
 * address it already has sleeps until DHCP hands out another one.
 *
 * Returns -EAGAIN when the timeout expires first. The link may still come up
 * later, because the driver keeps trying. Returns -ENOSPC when address cannot
 * hold the text, which takes NET_IPV4_ADDR_LEN bytes. One thread at a time
 * may wait.
 */
int wifi_link_wait_for_address(const char *known, k_timeout_t timeout, char *address,
			       size_t address_size);

#endif /* WIFI_LINK_H_ */
```
